VERSION "vhal_can_bridge_demo_phase2"

NS_ :

BS_:

BU_: CAN_BRIDGE

BO_ 291 PT_SPEED: 8 CAN_BRIDGE
 SG_ vehicle_speed_kph : 0|16@1+ (0.01,0) [0|655.35] "kph"  CAN_BRIDGE

BO_ 512 PT_STATUS: 8 CAN_BRIDGE
 SG_ engine_rpm : 0|16@1+ (0.25,0) [0|16383.75] "rpm"  CAN_BRIDGE

BO_ 514 PT_GEAR: 8 CAN_BRIDGE
 SG_ gear_position : 0|8@1+ (1,0) [0|15] "enum" CAN_BRIDGE

BO_ 513 HVAC_STATUS: 8 CAN_BRIDGE
 SG_ hvac_fan_level : 0|8@1+ (1,0) [0|7] "level" CAN_BRIDGE

CM_ BO_ 291 "Vehicle speed frame used for PERF_VEHICLE_SPEED mapping.";
CM_ BO_ 512 "Powertrain frame with RPM demo signal.";
CM_ BO_ 514 "Powertrain frame with gear demo signal.";
CM_ BO_ 513 "HVAC frame used for vendor read-only property demo.";
CM_ SG_ 512 gear_position "0=invalid,1=P,2=R,3=N,4=D";
